## CMakeLists.txt
```
# SPDX-License-Identifier: Apache-2.0

cmake_minimum_required(VERSION 3.20.0)
find_package(Zephyr REQUIRED HINTS $ENV{ZEPHYR_BASE})
project(cdc_acm)

FILE(GLOB app_sources src/*.c)
target_sources(app PRIVATE ${app_sources})
```

## sample.yaml
```
sample:
  name: CDC ACM USB
tests:
  sample.usb.cdc-acm:
    depends_on: usb_device
    tags: usb
    platform_exclude: native_posix native_posix_64
    harness: console
    harness_config:
      type: one_line
      regex:
        - "Wait for DTR"
  sample.usb.cdc-acm.comp:
    depends_on: usb_device
    tags: usb
    platform_exclude: native_posix native_posix_64
    extra_args: OVERLAY_CONFIG=overlay-composite-cdc-msc.conf
    harness: console
    harness_config:
      type: one_line
      regex:
        - "Wait for DTR"
  sample.usb.cdc-acm.buildonly:
    depends_on: usb_device
    tags: usb
    platform_allow: native_posix native_posix_64
    build_only: true
```

## prj.conf
```kconfig
CONFIG_STDOUT_CONSOLE=y
CONFIG_USB_DEVICE_STACK=y
CONFIG_USB_DEVICE_PRODUCT="Zephyr CDC ACM sample"
CONFIG_LOG=y
CONFIG_USB_DRIVER_LOG_LEVEL_ERR=y
CONFIG_USB_DEVICE_LOG_LEVEL_ERR=y
CONFIG_SERIAL=y
CONFIG_UART_INTERRUPT_DRIVEN=y
CONFIG_UART_LINE_CTRL=y
CONFIG_HEAP_MEM_POOL_SIZE=1024



# fs_dirent structures are big.
CONFIG_MAIN_STACK_SIZE=2048

# Let __ASSERT do its job
CONFIG_DEBUG=y
CONFIG_FLASH=y
CONFIG_FLASH_MAP=y
CONFIG_FLASH_PAGE_LAYOUT=y
CONFIG_FILE_SYSTEM=y
CONFIG_FILE_SYSTEM_LITTLEFS=y

CONFIG_I2C=y
```

## app.overlay
```dts
/*
 * Copyright (c) 2021 Nordic Semiconductor ASA
 *
 * SPDX-License-Identifier: Apache-2.0
 */

&zephyr_udc0 {
	cdc_acm_uart0 {
		compatible = "zephyr,cdc-acm-uart";
		label = "CDC_ACM_0";
	};
};

&i2c0 {
	sda-pin = <30>;
	scl-pin = <4>;
};
```

## src/main.c
```c
/*
 * Copyright (c) 2019 Intel Corporation
 *
 * SPDX-License-Identifier: Apache-2.0
 */

/**
 * @file
 * @brief Sample echo app for CDC ACM class
 *
 * Sample app for USB CDC ACM class driver. The received data is echoed back
 * to the serial port.
 */

#include <zephyr.h>
#include  "protocol-usb.h"
#include  "sensor_controller.h"


void main(void)
{	
	// NRF_USBD_Type 
	// DT_N_S_soc_S_uart_40002000_P_rx_pull_up
	// NRF_USBD->USBPULLUP =  USBD_USBPULLUP_CONNECT_Enabled << USBD_USBPULLUP_CONNECT_Pos;
	ConfigureUSB(); // COMUNICAÇÃO UART VIA USB
	ConfigureLFS(); // SISTEMA DE ARQUIVOS
	ConfigureSDP(); // SENSOR DE PRESÃO DIFERENCIAL SDP
	ConfigurePin(); // PINO DO LED
	ConfigureTimer(); // timer


	Readdata(0); // offset LPS
	Readdata(1); // Tabela de fluxo HSC
	Readdata(2); // Tabela de fluxo SDP
	Readdata(3); // pontos FIO2

	while(1){
		if(uart_irq_rx_ready(uart_dev)){
			ReadMsg();
		}
		if(flagCE){
			Telemetria();
		}
		k_sleep(K_MSEC(100));
	}
}
```

## src/protocol-usb.c
```c
#include  "protocol-usb.h"

struct ring_buf ringbuf;
uint8_t ring_buffer[RING_BUF_SIZE];

static uint8_t idCMD[6]={0x75,0x77,0x78,0x79,0x7B};

static StatesCMD *FUNC[6]={CMD1,CMD2,CMD3,CMD4,CMD5};
uint8_t flagMsgRx= 0;

char bufferACK[131];
uint8_t lenBufferACK = 0;

uint8_t flagUSBC = 0;
// uint8_t flagBLEC = 0;
uint8_t flagCE=0;
uint8_t flagTimer1=0;

struct k_timer my_timer;


const struct device *i2c_dev = DEVICE_DT_GET(DT_NODELABEL(i2c0));

const struct device *uart_dev ;


 /**
  * @brief crc16calc
  * 		Esta função faz o cálculo do CRC16 /CCITT-FALSE de uma sequência de dados.
  *
  * @param pData, recebe um ponteiro para os dados que serão inseridos do calculo.
  *
  * @param length, recebe o tamanho dos dados em bytes.
  */

 uint16_t crc16calc(char* pData, int length){

     uint8_t i;
     uint16_t wCrc = 0xffff;
     while (length--) {
         wCrc ^= *(unsigned char *)pData++ << 8;
         for (i=0; i < 8; i++)
             wCrc = wCrc & 0x8000 ? (wCrc << 1) ^ 0x1021 : wCrc << 1;
     }
     return wCrc & 0xffff;

 }

/**
 * @brief ReadMsg
 * 		Esta função ler e processa protocolos recebidos via UART.
 *
 * @param huart, recebe um ponteiro contendo a informação da UART.

 */

void ReadMsg(){
	uint8_t buffer[64];
	uint8_t commandAPayload[16];
	uint8_t crc[2];
	int rb_len;

	size_t len = MIN(ring_buf_space_get(&ringbuf),
					 sizeof(buffer));

	rb_len = uart_fifo_read(uart_dev, buffer, len);

	if(buffer[0]== 0x7E && buffer[rb_len-1] == 0xFF && rb_len >6){

		memcpy(commandAPayload,&buffer[1],rb_len -4);
		memcpy(crc,&buffer[rb_len-3],2);

		if( crc16calc(commandAPayload,rb_len -4 ) == (crc[0]<<8 | crc[1])){
			ProceduresMsg(commandAPayload);
		}
		else{
			char NAKMSG[] = {NACK,commandAPayload[1],0x0A};
			SendMsg(NAKMSG,3);
			lenBufferACK = 0;
		}
    }
}

static int ReadSensorI2C( uint8_t *buf, uint16_t addr, uint8_t len){
    return i2c_read(i2c_dev ,buf ,len ,addr);
}

static int WriteSensorI2C( uint8_t *buf, uint16_t addr, uint8_t len){
    return i2c_write(i2c_dev ,buf ,len ,addr);
}

void ConfigureSDP(){
	
	    char temp[9] = {0};
		char buf[2]={0x36,0x1e};

		WriteSensorI2C(buf,ADDRESS_SDP31,2);

		k_msleep(20);

		ReadSensorI2C(temp,ADDRESS_SDP31,9);

		k_usleep(500);

        escalaBufferSDP = temp[6] << 8 | temp[7];

		k_usleep(500);
}

void ConfigureUSB(){
    const struct device *dev;
	dev = DEVICE_DT_GET_ONE(zephyr_cdc_acm_uart);
	uart_dev = dev;
	uint32_t baudrate, dtr = 0U;
	int ret;

	if (!device_is_ready(dev)) {
		return;
	}
	ret = usb_enable(NULL);
	if (ret != 0){
		return;
	}
	ring_buf_init(&ringbuf, sizeof(ring_buffer), ring_buffer);

	// while (true) {
	// 	uart_line_ctrl_get(dev, UART_LINE_CTRL_DTR, &dtr);
	// 	if (dtr) {
	// 		break;
	// 	} else {
	// 		/* Give CPU resources to low priority threads. */
	// 		k_sleep(K_MSEC(100));
	// 	}
	// }
	// /* They are optional, we use them to test the interrupt endpoint */
	// ret = uart_line_ctrl_set(dev, UART_LINE_CTRL_DCD, 1);
	// ret = uart_line_ctrl_set(dev, UART_LINE_CTRL_DSR, 1);
	// /* Wait 1 sec for the host to do all settings */
	k_busy_wait(1000000);

	ret = uart_line_ctrl_get(dev, UART_LINE_CTRL_BAUD_RATE, &baudrate);
	// uart_irq_callback_set(dev, interrupt_handler); // MOD
	/* Enable rx interrupts */
	uart_irq_rx_enable(dev);
	uart_irq_tx_enable(dev); // MOD
}


/**
 * @brief SendMsg
 * 		Esta função inicia o processo de transmissão de uma mensagem.
 *
 * @param msg1, recebe o ponteiro dos dados que serão enviados
 *
 * @param len, recebe o tamanho dos dados em bytes.
 */
void SendMsg(char*msg1,int len){
	  char msg3[135];
	  EncapsulationMsgs(msg1,msg3,len);
	  uart_fifo_fill(uart_dev, msg3, len + 4);
}


/**
 * @brief EncapsulationMsgs
 * 		Esta função encapsula os dados a serem enviado para um protocolo.
 *
 * @param data1, recebe o ponteiro dos dados que serão encapsulados.
 *
 * @param data2, recebe o ponteiro da saída dos dados no formato do protocolo.
 *
 * @param len, recebe o tamanho dos dados em bytes.
 */

 void EncapsulationMsgs(char *data1,char *data2,int len){
	 int i = 1;
	 uint16_t aux;
	 data2[0]=0x7E;
	 for(;i<=len;i++)data2[i]=data1[i-1];
	 aux=crc16calc(data1,len);
	 data2[i+1] = aux;
	 data2[i]= aux>>8;
	 data2[i+2] = 0xFF;

 }


 
/**
 * @brief ProceduresMsg
 * 		Esta função inicia a leitura de um comando externo e direciona para a função adequada.
 *
 * @param data, recebe um ponteiro para os dados da mensagem.
 */
void ProceduresMsg(char *data) {
	char NAKMSG[] = { 0x15, data[1], data[1] };
	switch (data[0]) {
	case 0x20:
		for (uint8_t f = 0; f < 6; f++) {
			if (data[1] == idCMD[f]) {
				FUNC[f](data);
				break;
			}
		}
		break;
	case 0x15:
		if (lenBufferACK != 0)
			ProceduresMsg(bufferACK);
		break;
	case 0x06:
		lenBufferACK = 0;
		break;
	case 0x40:
		if (lenBufferACK != 0)
			SendMsg(bufferACK,lenBufferACK);
		break; 
	default:
		SendMsg(NAKMSG, 3);
		lenBufferACK = 0;
	}
}

//testes
void CMD1(char *data){
	char MSG[] = {ACK,data[1],data[2]};
	SendMsg(MSG,3);
    lenBufferACK = sizeof(MSG);
	memcpy(bufferACK,MSG,sizeof(MSG));
}

void CMD2(char *data){
    char MSG[] = {ACK, data[1], data[2]};
	if(data[2] == 0x12 || data[2] == 0x21){
		// SendMsg(MSG,3);
		if(data[2] == 0x12){
			flagCE = 1;
		}else{
			flagCE = 0;	
		}
	}
	else{
		MSG[0] = NACK;
		SendMsg(MSG,3);
	}
	lenBufferACK = 0;
}


// Zerar os transdutores
void CMD3(char *data){
        char MSG[] = {ACK, data[1], data[2],0,0};
		// char MSG[] = {ACK, data[1], data[2],0,0,0,0};
        // uint8_t bufferLPS[3]={0};
		uint8_t bufferSDP[3]={0};
		uint8_t bufferHSC[2]={0};
		signed short calc_press;

		tabela_HSC[0]=0;
		tabela_SDP[0]=0;
		offset_LPS[0]=0;

		int k = 0;

        if(data[2] == 0x12){
            
            // while (K<20){

			// 	ReadSensorI2C(bufferLPS, ADDRESS_LPS27HHW ,3);
			// 	k_usleep(5000);
            //     offset_LPS[0] += (((bufferLPS[2] << 16) & 0xFF0000)| ((bufferLPS[1] << 8) & 0xFF00)| (bufferLPS[0] & 0xFF)) / 4096.0;
                
            //     K++;
            // }
			// offset_LPS[0] = offset_LPS[0]/20.0;

			// Savedata(0);

			// char aux2[2];
			// int aux4;
            for(k = 0;k<32;k++){
				    
				ReadSensorI2C(bufferSDP, ADDRESS_SDP31 ,3);
				
				
				k_usleep(500);
				calc_press = ((bufferSDP[0]<<8 | bufferSDP[1]));
               	tabela_SDP[0]  += calc_press/((escalaBufferSDP) * 100.0);
				// aux4= (calc_press/((escalaBufferSDP) * 100.0))*1000/1;

				// aux4= abs(aux4);
				// aux2[0]= aux4>>8;
				// aux2[1]= aux4 & 0x00FF;
				// SendMsg(aux2,2);

            	ReadSensorI2C(bufferHSC, ADDRESS_HSC ,2);
				k_usleep(500);
                tabela_HSC[0] += ((((bufferHSC[0] & 0x3F)<<8 | bufferHSC[1])-0x0666)*(12.4541-(-12.4541))/(0x3999-0x0666) -12.4541);
				// aux4 =  (((((bufferHSC[0] & 0x3F)<<8 | bufferHSC[1])-0x0666)*(12.4541-(-12.4541))/(0x3999-0x0666) -12.4541))*1000/1;
				
				// aux4= abs(aux4);
				// aux2[0]= aux4>>8;
				// aux2[1]= aux4 & 0x00FF;
				// SendMsg(aux2,2);
			
			}

			tabela_SDP[0]=tabela_SDP[0]/32.0;
			Savedata(2);

			tabela_HSC[0]=tabela_HSC[0]/32.0;
			Savedata(1);

			//BEGIN::AREA RESERVADA PARA DEBUGAR PROTOCOLO, MANTER COMENTADO!
			
			//END::AREA RESERVADA

			SendMsg(MSG,5);
			lenBufferACK = sizeof(MSG);
			memcpy(bufferACK,MSG,sizeof(MSG));
        }
		else{
			MSG[0]= NACK;
			SendMsg(MSG,5);
			lenBufferACK = 0;
		}
}


void CMD4(char *data){
    char MSG[] = {ACK, data[1], data[2],0,0};
	//  char MSG[] = {ACK, data[1], data[2],0,0,0,0};
	uint8_t bufferSDP[3]={0};
	uint8_t bufferHSC[2]={0};
	signed short calc_press;

	tabela_HSC[data[2]]=0;
	tabela_SDP[data[2]]=0;

	int k = 0;
	
	char aux3[4];
	char aux2[4];
	for(k = 0;k<32;k++){
		ReadSensorI2C(bufferSDP, ADDRESS_SDP31 ,3);
		k_usleep(500);
		calc_press = ((bufferSDP[0]<<8 | bufferSDP[1]));
		tabela_SDP[data[2]]  += calc_press/((escalaBufferSDP) * 100.0);

		ReadSensorI2C(bufferHSC, ADDRESS_HSC ,2);
		k_usleep(500);
		tabela_HSC[data[2]] += ((((bufferHSC[0] & 0x3F)<<8 | bufferHSC[1])-0x0666)*(12.4541-(-12.4541))/(0x3999-0x0666) -12.4541);
	}

	tabela_SDP[data[2]]=abs((tabela_SDP[data[2]]/32.0)-tabela_SDP[0]);
	Savedata(2);

	tabela_HSC[data[2]]=abs((tabela_HSC[data[2]]/32.0) - tabela_HSC[0]);
	Savedata(1);

	//BEGIN::AREA RESERVADA PARA DEBUGAR PROTOCOLO, MANTER COMENTADO!

	//END::AREA RESERVADA


	int aux = (tabela_HSC[data[2]]*1000)/1;
	MSG[3]= aux>>8;
	MSG[4]= aux & 0x00FF;

	SendMsg(MSG,5);
	lenBufferACK = sizeof(MSG);
	memcpy(bufferACK,MSG,sizeof(MSG));
}

void CMD5(char *data){
	char MSG[128] ={0};
	MSG[0] = ACK;
	MSG[1] = data[1];
	int aux = 0;
	
	for(int i=0;i<43;i++){
		MSG[i*3+2] = tabflow[i];
		if(i < 29){
			aux = (tabela_SDP[i]*1000)/1;
		}else{
			aux = (tabela_HSC[i]*1000)/1;
		}
		MSG[i*3+3] = aux>>8;
		MSG[i*3+4] = aux & 0x00FF;
	}

	SendMsg(MSG,128);
    lenBufferACK = sizeof(MSG);
	memcpy(bufferACK,MSG,sizeof(MSG));
}

void Telemetria(){
	char MSG[] = {ACK,0x77,0,0,0,0,0,0};
	uint8_t bufferSDP[3]={0};
	uint8_t bufferHSC[2]={0};
	signed short calc_press;
	int auxEV = 0;
	float SDP = 0;
	float HSC = 0;
	float fluxoSDP = 0;
	float fluxoHSC = 0;
	flagTimer1 = 0;
	k_timer_start(&my_timer,K_USEC(750), K_USEC(750));
	while(flagCE){
			gpio_pin_set(dev1, PIN, (int)led_is_on);
			led_is_on = !led_is_on;
			ReadSensorI2C(bufferHSC, ADDRESS_HSC ,2);

			while(!flagTimer1);  
			flagTimer1 = 0;

			ReadSensorI2C(bufferSDP, ADDRESS_SDP31 ,3);

			HSC = ((((bufferHSC[0] & 0x3F)<<8 | bufferHSC[1])-0x0666)*(12.4541-(-12.4541))/(0x3999-0x0666) -12.4541);
			HSC = HSC - tabela_HSC[0];
			fluxoHSC = FlowCalc(HSC, tabela_HSC);

			while(!flagTimer1);
			flagTimer1 = 0;

			calc_press = ((bufferSDP[0]<<8 | bufferSDP[1]));
			SDP = (calc_press/((escalaBufferSDP) * 100.0));
			SDP = SDP - tabela_SDP[0];
			fluxoSDP = FlowCalc(SDP, tabela_SDP);


			if((60 >= abs(fluxoSDP) &&   20 >= abs(abs(fluxoSDP) - abs(fluxoHSC)))){
				auxEV = (fluxoSDP*100)/1;
			}else{
				auxEV = (HSC*100)/1;	
			}

			MSG[4] = auxEV>>8;
			MSG[5] = auxEV & 0xFF;

			SendMsg(MSG,8);
    		lenBufferACK = sizeof(MSG);
			memcpy(bufferACK,MSG,sizeof(MSG));

			if(uart_irq_rx_ready(uart_dev)){
				ReadMsg();
			}
	}
	k_timer_stop(&my_timer);
}

	void ExpiryF(struct k_timer *timer_id){
		flagTimer1 = 1;
	}

    void ConfigureTimer(){
		k_timer_init(&my_timer, ExpiryF, NULL);
    }
```

## src/protocol-usb.h
```c
#pragma once

#include <stdio.h>
#include <string.h>
#include <device.h>
#include <drivers/uart.h>
#include <zephyr.h>
#include <sys/ring_buffer.h>

#include <usb/usb_device.h>
#include <logging/log.h>

#include <kernel.h>


#include  "tablesFS.h"
#include  "sensor_controller.h"


#define RING_BUF_SIZE 1024

#define HEADER 0x76
#define FOOTER 0xFF
#define NACK   0x15
#define ACK    0x06

extern const struct device *uart_dev;
extern uint8_t flagMsgRx;

extern struct ring_buf ringbuf;
extern uint8_t ring_buffer[RING_BUF_SIZE];

extern uint8_t flagCE; 

typedef void StatesCMD(char * Dados);


void CMD1(char * data); // Calibração do sensor de oxigênio
void CMD2(char * data); // Leitura da carga de bateria  
void CMD3(char * data); // Leituras do fluxo, pressão e FiO2
void CMD4(char * data); // Zerar os transdutores
void CMD5(char * data); // Calibrar um ponto de fluxo
void CMD6(char * data); // Leitura da tabela de calibração atualizada


uint16_t crc16calc(char* pData, int length);
void ConfigureUSB();
void ConfigureSDP();
void ReadMsg();
void EncapsulationMsgs(char *data1,char *data2,int len);
void SendMsg(char*msg1,int len);
void ProceduresMsg(char *data);

void Telemetria();

void ExpiryF(struct k_timer *timer_id);
void ConfigureTimer();
```

## src/sensor_controller.c
```c
#include "sensor_controller.h"
int TAMANHO_TABELAS =43;
int escalaBufferSDP = 1;

const struct device *dev1;
bool led_is_on = true;
int ret1;

uint8_t tabflow[43] = {0, 1, 2, 3, 4, 5, 6, 7, 8, 9, 10, 12, 14, 16, 18, 20, 22, 24, 26, 28, 30, 32, 34, 36, 38,
                                           40, 45, 50, 60, 70, 80, 90, 100, 110, 120, 130, 140, 150, 160, 170, 180, 190, 200};

 float MapFloat(float value, float fromLow, float fromHigh, float toLow, float toHigh) {
    return (value - fromLow) * (toHigh - toLow) / (fromHigh - fromLow) + toLow; 
  }

  float FlowCalc(float dpvalue, float tabela_calib[TAMANHO_TABELAS]){
    if(abs(dpvalue) < tabela_calib[1]){
      if(dpvalue <= 0){
        return (MapFloat(abs(dpvalue), 0, tabela_calib[1], tabflow[0], tabflow[1]));
      }
      return (MapFloat(abs(dpvalue), 0, tabela_calib[1], tabflow[0], tabflow[1])*(-1));
    }
    for(int i = 1; i < TAMANHO_TABELAS; i++){
      if(tabela_calib[i] <= abs(dpvalue) && abs(dpvalue) < tabela_calib[i+1]){
        if(dpvalue <= 0){
          return (MapFloat(abs(dpvalue), tabela_calib[i], tabela_calib[i+1], tabflow[i], tabflow[i+1]));
        }
        return (MapFloat(abs(dpvalue), tabela_calib[i], tabela_calib[i+1], tabflow[i], tabflow[i+1])*(-1));
      }
    }
    return -1;
  }

void ConfigurePin(){

		dev1 = device_get_binding(LED0);
		if (dev1 == NULL) {
			return;
		}

		ret1 = gpio_pin_configure(dev1, PIN, GPIO_OUTPUT_ACTIVE | FLAGS);
		if (ret1 < 0) {
			return;
		}

}
```

## src/sensor_controller.h
```c
#pragma once

#include <stdio.h>
#include <string.h>
#include <zephyr.h>
#include <device.h>
#include <devicetree.h>
#include <drivers/i2c.h>
#include <drivers/gpio.h>

#define LED0_NODE DT_ALIAS(led0)
#define LED0	DT_GPIO_LABEL(LED0_NODE, gpios)
#define PIN	DT_GPIO_PIN(LED0_NODE, gpios)
#define FLAGS	DT_GPIO_FLAGS(LED0_NODE, gpios)

#define abs(x) ((x)>0?(x):-(x))

#define ADDRESS_HSC  0x78
#define ADDRESS_SDP31  0x21
#define ADDRESS_LPS27HHW  0x5c

extern const struct device *dev1;
extern bool led_is_on;
extern int ret1;

extern int escalaBufferSDP;



//  int WriteSensorI2C( uint8_t *buf, uint16_t addr, uint8_t len);

// int ReadSensorI2C( uint8_t *buf, uint16_t addr, uint8_t len);

extern const struct device *i2c_dev; 

extern uint8_t tabflow[43];


float MapFloat(float value, float fromLow, float fromHigh, float toLow, float toHigh);
float FlowCalc(float dpvalue, float tabela_calib[43]);

void ConfigurePin();
```

## src/tablesFS.c
```c
/*
 * Copyright (c) 2019 Peter Bigot Consulting, LLC
 *
 * SPDX-License-Identifier: Apache-2.0
 */

/* Sample which uses the filesystem API with littlefs */
#include "tablesFS.h"

/* Matches LFS_NAME_MAX */
#define MAX_PATH_LEN  255 //255

#define PARTITION_NODE DT_NODELABEL(lfs1)

#if DT_NODE_EXISTS(PARTITION_NODE)
FS_FSTAB_DECLARE_ENTRY(PARTITION_NODE);
#else /* PARTITION_NODE */
FS_LITTLEFS_DECLARE_DEFAULT_CONFIG(storage);
static struct fs_mount_t lfs_storage_mnt = {
	.type = FS_LITTLEFS,
	.fs_data = &storage,
	.storage_dev = (void *)FLASH_AREA_ID(storage),
	.mnt_point = "/lfs",
};
#endif /* PARTITION_NODE */


struct fs_mount_t *fREF;

char fnameLPS[MAX_PATH_LEN];
char fnameHSC[MAX_PATH_LEN];
char fnameSDP[MAX_PATH_LEN];
char fnameFIO2[MAX_PATH_LEN];

int flagfiles[4]={0,0,0,0};

struct fs_file_t fLPS;
struct fs_file_t fHSC;
struct fs_file_t fSDP;
struct fs_file_t fFIO2;

struct fs_dirent dirent;

float tabela_HSC[43]={0}; 
float tabela_SDP[43]={0}; 
float tabela_FIO2[2]={0};
float offset_LPS[1] = {0};

void ConfigureLFS(void)
{
	struct fs_mount_t *mp =
#if DT_NODE_EXISTS(PARTITION_NODE)
		&FS_FSTAB_ENTRY(PARTITION_NODE)
#else
		&lfs_storage_mnt
#endif
		;
	unsigned int id = (uintptr_t)mp->storage_dev;

	struct fs_statvfs sbuf;
	const struct flash_area *pfa;
	int rc;

	snprintf(fnameLPS, sizeof(fnameLPS), "%s/offsetLPS", mp->mnt_point);
	snprintf(fnameHSC, sizeof(fnameHSC), "%s/tableHSC", mp->mnt_point);
	snprintf(fnameSDP, sizeof(fnameSDP), "%s/tableSDP", mp->mnt_point);
	snprintf(fnameFIO2, sizeof(fnameFIO2), "%s/tableFIO2", mp->mnt_point);

	rc = flash_area_open(id, &pfa);
	if (rc < 0)return;
	/* Optional wipe flash contents */
	if (IS_ENABLED(CONFIG_APP_WIPE_STORAGE)) {
		rc = flash_area_erase(pfa, 0, pfa->fa_size);
	}

	flash_area_close(pfa);

	/* Do not mount if auto-mount has been enabled */
#if !DT_NODE_EXISTS(PARTITION_NODE) ||						\
	!(FSTAB_ENTRY_DT_MOUNT_FLAGS(PARTITION_NODE) & FS_MOUNT_FLAG_AUTOMOUNT)
	rc = fs_mount(mp);
	if (rc < 0) {
		// printk("FAIL: mount id %" PRIuPTR " at %s: %d\n",
		//        (uintptr_t)mp->storage_dev, mp->mnt_point, rc);
		return;
	}
	// printk("%s mount: %d\n", mp->mnt_point, rc);
#else
	// printk("%s automounted\n", mp->mnt_point);
#endif

	rc = fs_statvfs(mp->mnt_point, &sbuf);
	fREF = mp;

	fs_file_t_init(&fLPS);

	flagfiles[0] = fs_stat(fnameLPS, &dirent);

	fs_file_t_init(&fHSC);

	flagfiles[1] = fs_stat(fnameHSC, &dirent);
	
	fs_file_t_init(&fSDP);

	flagfiles[2] = fs_stat(fnameSDP, &dirent);
	
	
	fs_file_t_init(&fFIO2);

	flagfiles[3] = fs_stat(fnameFIO2, &dirent);

}

void Savedata(int tipo){

	struct fs_file_t *file;
	char *fname;
	int len = 0;
	float *data;
	int rc;
	
	switch(tipo){
		case 0:
			file = &fLPS;
			fname = fnameLPS;
			len = 1;
			data =  offset_LPS;
			break;
		case 1:
			file = &fHSC;
			fname = fnameHSC;
			len = 43;
			data = tabela_HSC;
			break;
		case 2:
			file = &fSDP;
			fname = fnameSDP;
			len = 43;
			data = tabela_SDP;
			break;
		case 3:
			file = &fFIO2;
			fname = fnameFIO2;
			len = 2;
			data = tabela_FIO2;
			break;
		default:
			return;
	}
	rc = fs_open(file, fname, FS_O_CREATE | FS_O_RDWR);
	for(int i=0;i<len;i++){
			rc = fs_write(file, &data[i], sizeof(float));
		}
	rc = fs_seek(file, 0, FS_SEEK_SET);
	rc = fs_close(file);


}	

void Readdata(int tipo){
	struct fs_file_t *file;
	char *fname;
	int len = 0;
	float *data;
	int rc;
	switch(tipo){
		case 0:
			file = &fLPS;
			fname = fnameLPS;
			len = 1;
			data =  offset_LPS;
			break;
		case 1:
			file = &fHSC;
			fname = fnameHSC;
			len = 43;
			data = tabela_HSC;
			break;
		case 2:
			file = &fSDP;
			fname = fnameSDP;
			len = 43;
			data = tabela_SDP;
			break;
		case 3:
			file = &fFIO2;
			fname = fnameFIO2;
			len = 2;
			data = tabela_FIO2;
			break;
		default:
			return;
	}

	rc = fs_open(file, fname, FS_O_CREATE | FS_O_RDWR);

	if (rc >= 0) {
		for(int i=0;i<len;i++){
			rc = fs_read(file, &data[i], sizeof(float));
		}
	}else{
		for(int i=0;i<len;i++){
			rc = fs_write(file, &data[i], sizeof(float));
		}
	}
	
	rc = fs_seek(file, 0, FS_SEEK_SET);
	rc = fs_close(file);

}


// uint32_t CFSTEST2(){
	
// 	// uint32_t lFSC =  CFSTEST2();
// 	// uint8_t lFSCV[4];
	
// 	// memcpy(lFSCV,&lFSC,4); 
// 	// SendMsg(lFSCV,4);

// 		readdata(0);
// 		offset_LPS[0]++;
// 		savedata(0);

// 		readdata(2);
// 		tabela_SDP[1]+=1.5;
// 		savedata(2);
// 		return  (int)(tabela_SDP[1]*10);
// }
```

## src/tablesFS.h
```c
#pragma once

#include <stdio.h>
#include <zephyr.h>
#include <device.h>
#include <fs/fs.h>
#include <fs/littlefs.h>
#include <storage/flash_map.h>

#include <string.h>

#define  FLPS  0x00
#define  FHSC  0x01
#define  FSDP  0x02
#define  FFIO2 0x03 

extern float tabela_HSC[43]; 
extern float tabela_SDP[43];
extern float tabela_FIO2[2];
extern float offset_LPS[1];

void ConfigureLFS(void);

void Readdata(int tipo);
void Savedata(int tipo);
```
